## Kconfig
```kconfig
# SPDX-License-Identifier: Apache-2.0

config ROPODS_DRIVERS
	bool "ROPODS drivers"
	help
	  Enable ROPODS custom drivers

if ROPODS_DRIVERS

rsource "drivers/Kconfig"

endif # ROPODS_DRIVERS

config ROPODS_LIBRARIES
	bool "ROPODS libraries"
	help
	  Enable ROPODS custom libraries

if ROPODS_LIBRARIES

rsource "lib/src/Kconfig"

endif # ROPODS_LIBRARIES
```

## boards/ropods/ppod_v2p0/Kconfig
```kconfig
# PPOD_V2P0 board configuration

# Copyright (c) 2018 Nordic Semiconductor ASA
# SPDX-License-Identifier: Apache-2.0

# PPOD_V2P0 board configuration

# Copyright (c) 2018 Nordic Semiconductor ASA
# SPDX-License-Identifier: Apache-2.0

if BOARD_PPOD_V2P0

config BOARD_ENABLE_DCDC
	bool "Enable DCDC mode"
	select SOC_DCDC_NRF52X
	default y

config BOARD_HAS_NRF5_BOOTLOADER
	bool "Board has nRF5 bootloader"
	default n
	help
	  If selected, applications are linked so that they can be loaded by Nordic
	  nRF5 bootloader.

config BOARD_VDD_PWR_CTRL_INIT_PRIORITY
	int "VDD power rail init priority"
	default 50
	depends on GPIO
	help
	  Initialization priority for the VDD power rail. Has to be greater
	  than GPIO_NRF_INIT_PRIORITY.

config POWER_ON_FLASH_TIMES
	int "LED flash count during power on"
	default 6
	help
	  LED flash count during power on

config POWER_ON_LED_FLASH_DELAY
	int "LED flash delay during power on"
	default 500
	help
	  Delay between LED flashes in ms

config POWER_OFF_FLASH_TIMES
	int "LED flash count during power off"
	default 6
	help
	  LED flash count during power off

config POWER_OFF_LED_FLASH_DELAY
	int "LED flash delay during power off"
	default 500
	help
	  Delay between LED flashes in ms

config PPOD_V2P0_UTILS
	bool "Enable PPOD v2.0 utility functions"
	default y
	help
	  Enable utility functions for power management and charge status

endif # BOARD_PPOD_V2P0
```

## boards/ropods/ppod_v2p0/Kconfig.ppod_v2p0
```kconfig
# PPOD_V2P0 board configuration

# Copyright (c) 2018 Nordic Semiconductor ASA
# SPDX-License-Identifier: Apache-2.0

config BOARD_PPOD_V2P0
	select SOC_NRF52840_QIAA
	select SOC_SERIES_NRF52X
	select SOC_FAMILY_NORDIC_NRF
```

## boards/ropods/ppod_v2p0/board.yml
```yaml
board:
  name: ppod_v2p0
  full_name: nRF52840-PPOD v2.0
  vendor: ppod
  socs:
  - name: nrf52840
```

## boards/ropods/ppod_v2p0/ppod_v2p0_defconfig
```kconfig
# SPDX-License-Identifier: Apache-2.0

# Enable MPU
CONFIG_ARM_MPU=y

# Enable hardware stack protection
CONFIG_HW_STACK_PROTECTION=y

# Enable RTT
CONFIG_USE_SEGGER_RTT=y

# enable GPIO
CONFIG_GPIO=y

# Enable UART driver, needed for CDC ACM
CONFIG_SERIAL=y
CONFIG_UART_INTERRUPT_DRIVEN=y

# enable console
CONFIG_CONSOLE=y
CONFIG_UART_CONSOLE=n
CONFIG_RTT_CONSOLE=n

# additional board options
CONFIG_GPIO_AS_PINRESET=n
CONFIG_NFCT_PINS_AS_GPIOS=y

CONFIG_CLOCK_CONTROL_NRF_K32SRC_RC=y
CONFIG_CLOCK_CONTROL_NRF_K32SRC_XTAL=n

# Use nano libc for smaller footprint (default for ppod_v2p0)
CONFIG_NEWLIB_LIBC=y
CONFIG_NEWLIB_LIBC_NANO=y
```

## drivers/sensor/Kconfig
```kconfig
# SPDX-License-Identifier: Apache-2.0

config ICM20948
	bool "ICM20948 9-axis motion tracking device"
	default y
	depends on SPI
	select SENSOR_ASYNC_API if ICM20948_TRIGGER
	help
	  Enable driver for ICM20948 9-axis motion tracking device.

if ICM20948

choice ICM20948_TRIGGER_MODE
	prompt "Trigger mode"
	default ICM20948_TRIGGER_GLOBAL_THREAD
	help
	  Specify the type of triggering to be used by the driver.

config ICM20948_TRIGGER_NONE
	bool "No trigger"

config ICM20948_TRIGGER_GLOBAL_THREAD
	bool "Use global thread"
	depends on GPIO
	select ICM20948_TRIGGER

config ICM20948_TRIGGER_OWN_THREAD
	bool "Use own thread"
	depends on GPIO
	select ICM20948_TRIGGER

endchoice

config ICM20948_TRIGGER
	bool

config ICM20948_THREAD_PRIORITY
	int "Thread priority"
	depends on ICM20948_TRIGGER_OWN_THREAD
	default 10
	help
	  Priority of thread used by the driver to handle interrupts.

config ICM20948_THREAD_STACK_SIZE
	int "Thread stack size"
	depends on ICM20948_TRIGGER_OWN_THREAD
	default 1024
	help
	  Stack size of thread used by the driver to handle interrupts.

endif # ICM20948
```

## drivers/sensor/icm20948/Kconfig
```kconfig
# SPDX-License-Identifier: Apache-2.0

# InvenSense ICM-20948 9-axis motion sensor

config ICM20948
	bool "InvenSense ICM-20948 9-axis motion sensor"
	depends on SPI && SENSOR
	select ICM20948_SPI
	help
	  Enable driver for InvenSense ICM-20948 9-axis motion sensor.
	  This driver supports SPI interface only.

if ICM20948

config ICM20948_SPI
	bool "ICM-20948 SPI support"
	depends on SPI
	default y
	help
	  Enable SPI support for ICM-20948 sensor.

config ICM20948_TRIGGER
	bool "ICM-20948 Trigger Support"
	depends on GPIO
	help
	  Enable trigger support for ICM-20948 sensor.

if ICM20948_TRIGGER

config ICM20948_TRIGGER_GLOBAL_THREAD
	bool "Use global thread for triggers"
	default y
	help
	  Use the global sensor trigger thread for interrupt handling.

config ICM20948_TRIGGER_OWN_THREAD
	bool "Use own thread for triggers"
	help
	  Use the sensor's own trigger thread for interrupt handling.

config ICM20948_THREAD_STACK_SIZE
	int "Thread stack size"
	depends on ICM20948_TRIGGER_OWN_THREAD
	default 1024
	help
	  Stack size for the sensor's own trigger thread.

endif # ICM20948_TRIGGER

config ICM20948_AUX_I2C
	bool "Enable auxiliary I2C for magnetometer"
	default y
	help
	  Enable auxiliary I2C interface for accessing the built-in
	  AK09916 magnetometer.

config ICM20948_DMP
	bool "Enable DMP (Digital Motion Processor)"
	default y
	help
	  Enable Digital Motion Processor (DMP) functionality.
	  This loads the DMP firmware and enables advanced motion
	  processing algorithms including sensor fusion, tap detection,
	  and other motion-based features.

endif # ICM20948
```

## dts/bindings/sensor/invensense,icm20948.yaml
```yaml
# Copyright (c) 2024 ROPODS
# SPDX-License-Identifier: Apache-2.0

description: |
  InvenSense ICM20948 9-axis motion tracking device

compatible: "invensense,icm20948"

include: [sensor-device.yaml, spi-device.yaml]

properties:
  int-gpios:
    type: phandle-array
    description: |
      The INT pin defaults to active high when produced by the sensor.
      The property value should ensure the flags properly describe the signal
      that is presented to the driver.

  accel-range:
    type: int
    default: 2
    description: |
      Range in g for the accelerometer.
      Valid values are 2, 4, 8, 16
    enum:
      - 2
      - 4
      - 8
      - 16

  gyro-range:
    type: int
    default: 250
    description: |
      Range in degrees per second for the gyroscope.
      Valid values are 250, 500, 1000, 2000
    enum:
      - 250
      - 500
      - 1000
      - 2000

  accel-dlpf:
    type: int
    default: 6
    description: |
      Digital Low Pass Filter setting for accelerometer.
      Valid values are 0-7, where 7 disables the filter.
    enum:
      - 0
      - 1
      - 2
      - 3
      - 4
      - 5
      - 6
      - 7

  gyro-dlpf:
    type: int
    default: 6
    description: |
      Digital Low Pass Filter setting for gyroscope.
      Valid values are 0-7, where 7 disables the filter.
    enum:
      - 0
      - 1
      - 2
      - 3
      - 4
      - 5
      - 6
      - 7

  mount-matrix:
    type: array
    description: |
      Mounting matrix for sensor orientation transformation.
      3x3 rotation matrix elements in row-major order.
      Default is identity matrix (no transformation).
      Each element should be -1, 0, or 1.
    default: [1, 0, 0, 0, 1, 0, 0, 0, 1]
```

## lib/src/Kconfig
```kconfig
# Kconfig for Sensor Manager

config SENSOR_MANAGER
	bool "Enable Sensor Manager"
	default y
	depends on SENSOR
	help
	  Enable the sensor manager library for handling multiple sensor devices
	  with timestamped data buffering and trigger-based data acquisition.

if SENSOR_MANAGER

config SENSOR_MANAGER_MAX_DEVICES
	int "Maximum number of sensor devices"
	default 8
	range 1 32
	help
	  Maximum number of sensor devices that can be managed simultaneously.

config SENSOR_MANAGER_MAX_CHANNELS_PER_DEVICE
	int "Maximum channels per device"
	default 16
	range 1 64
	help
	  Maximum number of channels that can be enabled per sensor device.

config SENSOR_MANAGER_DEFAULT_BUFFER_SIZE
	int "Default buffer size (entries)"
	default 64
	range 8 1024
	help
	  Default number of data entries to buffer per sensor device.
	  Each entry contains timestamp and sensor value.

config SENSOR_MANAGER_LOG_LEVEL
	int "Sensor Manager log level"
	default 3
	range 0 4
	help
	  Log level for sensor manager:
	  0 = Off, 1 = Error, 2 = Warning, 3 = Info, 4 = Debug

config SENSOR_MANAGER_DEBUG
	bool "Enable debug mode"
	default n
	help
	  Enable debug mode for additional logging and validation.

config SENSOR_MANAGER_THREAD_SAFE
	bool "Thread-safe operations"
	default y
	help
	  Enable thread-safe operations using mutexes. Disable only if
	  sensor manager will be used from a single thread.

endif # SENSOR_MANAGER

# ROPODS BLE Service Configuration
config ROPODS_BLE_SERVICE
	bool "Enable ROPODS BLE Service"
	default n
	depends on BT && BT_PERIPHERAL
	help
	  Enable the generic ROPODS BLE service for streaming sensor data
	  and device control over Bluetooth Low Energy.

if ROPODS_BLE_SERVICE

config ROPODS_BLE_DEVICE_NAME
	string "Default BLE device name"
	default "ROPODS-Device"
	help
	  Default device name to advertise over BLE.

config ROPODS_BLE_MAX_DEVICES
	int "Maximum number of devices in device info"
	default 8
	range 1 32
	help
	  Maximum number of devices that can be reported in the device
	  information characteristic.

config ROPODS_BLE_LOG_LEVEL
	int "ROPODS BLE Service log level"
	default 3
	range 0 4
	help
	  Log level for ROPODS BLE service:
	  0 = Off, 1 = Error, 2 = Warning, 3 = Info, 4 = Debug

config ROPODS_BLE_AUTO_START_ADVERTISING
	bool "Auto-start advertising on init"
	default y
	help
	  Automatically start BLE advertising when the service is initialized.

config ROPODS_BLE_CONNECTION_TIMEOUT
	int "Connection timeout (seconds)"
	default 60
	range 10 3600
	help
	  Timeout for BLE connections in seconds. Set to 0 to disable timeout.

endif # ROPODS_BLE_SERVICE
```

## west.yml
```yaml
manifest:
  defaults:
    remote: zephyrproject-rtos
    revision: v4.1.0
  remotes:
    - name: zephyrproject-rtos
      url-base: https://github.com/zephyrproject-rtos
  projects:
    - name: zephyr
      remote: zephyrproject-rtos
      revision: v4.1.0
      import:
        # Import only essential modules for nRF52DK sensor development
        name-allowlist:
          - cmsis          # ARM CMSIS headers (required for ARM targets)
          - hal_nordic     # Nordic HAL (required for nRF52DK/nRF52832)
          - segger         # Segger RTT for debugging and logging
          - mbedtls        # Crypto library (required for BLE)
  self:
    path: ropods-zephyr
```
